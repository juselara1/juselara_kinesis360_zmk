#define VERSION_MACRO
macro_ver: macro_ver {
compatible = "zmk,behavior-macro";
label = "macro_ver";
#binding-cells = <0>;
bindings = <&kp N2>, <&kp N0>, <&kp N2>, <&kp N4>, <&kp N0>, <&kp N5>, <&kp N1>, <&kp N5>, <&kp MINUS>, <&kp M>, <&kp A>, <&kp S>, <&kp T>, <&kp MINUS>, <&kp N0>, <&kp A>, <&kp N8>, <&kp D>, <&kp N7>, <&kp N9>, <&kp N6>, <&kp RET>;
};
